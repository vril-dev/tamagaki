## Config.in
```kconfig
source "$BR2_EXTERNAL_TAMAGAKI_PATH/package/tamagaki/Config.in"
source "$BR2_EXTERNAL_TAMAGAKI_PATH/package/tukuyomi-edge/Config.in"
```

## configs/tamagaki_defconfig
```kconfig
BR2_aarch64=y
BR2_TOOLCHAIN_BUILDROOT_MUSL=y
BR2_TOOLCHAIN_BUILDROOT_CXX=y

BR2_LINUX_KERNEL=y
BR2_LINUX_KERNEL_CUSTOM_VERSION=y
BR2_LINUX_KERNEL_CUSTOM_VERSION_VALUE="6.6"
BR2_LINUX_KERNEL_CONFIG_FRAGMENT_FILES="$(BR2_EXTERNAL_TAMAGAKI_PATH)/board/tamagaki/kernel.config"

BR2_TARGET_UBOOT=y
BR2_TARGET_UBOOT_CONFIG_FRAGMENT_FILES="$(BR2_EXTERNAL_TAMAGAKI_PATH)/board/tamagaki/uboot.config"

BR2_ROOTFS_OVERLAY="$(BR2_EXTERNAL_TAMAGAKI_PATH)/board/tamagaki/rootfs-overlay"
BR2_ROOTFS_POST_BUILD_SCRIPT="$(BR2_EXTERNAL_TAMAGAKI_PATH)/board/tamagaki/post-build.sh"

BR2_INIT_BUSYBOX=y
BR2_PACKAGE_BUSYBOX=y
BR2_PACKAGE_NFTABLES=y
BR2_PACKAGE_UBOOT_TOOLS=y

BR2_CCACHE=y
BR2_STRIP_strip=y

BR2_PACKAGE_TAMAGAKI=y
# BR2_PACKAGE_TUKUYOMI_EDGE is not set

# Keep the image minimal while tukuyomi-edge artifacts are not published.
BR2_PACKAGE_PERL=n
BR2_PACKAGE_PYTHON3=n
```

## package/tamagaki/Config.in
```kconfig
config BR2_PACKAGE_TAMAGAKI
    bool "tamagaki"
    depends on BR2_INSTALL_LIBSTDCPP
    select BR2_PACKAGE_LIBBPF
    help
      Tamagaki userspace agent built from the local br2-external tree.

      This package installs:
        - /usr/bin/tamagaki
        - /usr/libexec/tamagaki-notify-boot

comment "tamagaki needs a toolchain w/ C++"
    depends on !BR2_INSTALL_LIBSTDCPP
```

## package/tukuyomi-edge/Config.in
```kconfig
config BR2_PACKAGE_TUKUYOMI_EDGE
    bool "tukuyomi-edge"
    help
      External Go binary used for the HTTP reverse proxy / Coraza path.

      Leave this disabled until the matching GitHub Release artifact exists.
```
